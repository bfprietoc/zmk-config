&i2c1 {
    status = "okay";
    compatible = "nordic,nrf-twim";
    sda-pin = <17>;
    scl-pin = <20>;

    oled_display: oled_display@3d {
        compatible = "solomon,ssd1306";
        reg = <0x3D>;
        label = "OLED Display";
    };
};
